## source/android/vendor/oplus/kernel/oplus_performance/oppo_healthinfo/fs/fg_uid/Kconfig
```kconfig
#ifdef VENDOR_EDIT
config FG_TASK_UID
	bool "Enable /proc/fg_info/ if EXPERT"
	default y
	help
	  Add foreground process optimize support to promote performance .
#endif /*VENDOR_EDIT*/
```
