## source/android/vendor/oplus/kernel/oplus_performance/foreground_io_opt/Kconfig
```kconfig
# SPDX-License-Identifier: GPL-2.0-only
# Copyright (C) 2018-2020 Oplus. All rights reserved.

config OPLUS_FG_IO_OPT
       bool "Enable foreground io optimization"
       default y
       help
         foreground io optimization
```
